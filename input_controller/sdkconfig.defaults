## input_controller/sdkconfig.defaults
```kconfig
# Target: Waveshare ESP32-C6-Touch-LCD-1.47
CONFIG_IDF_TARGET="esp32c6"

# Flash
CONFIG_ESPTOOLPY_FLASHSIZE_4MB=y
CONFIG_ESPTOOLPY_FLASHMODE_QIO=y

# FreeRTOS
CONFIG_FREERTOS_HZ=1000

# Main task stack -- needs headroom for hardware init
CONFIG_ESP_MAIN_TASK_STACK_SIZE=8192

# LVGL -- the JD9853 on this board expects byte-swapped RGB565
CONFIG_LV_COLOR_16_SWAP=y

# LVGL heap budget
CONFIG_LV_MEM_SIZE_KILOBYTES=48

# Fonts used by the navigation guide UI
CONFIG_LV_FONT_MONTSERRAT_12=y
CONFIG_LV_FONT_MONTSERRAT_14=y
CONFIG_LV_FONT_DEFAULT_MONTSERRAT_14=y

# LVGL built-in symbols (arrows) require the symbol font
CONFIG_LV_FONT_MONTSERRAT_16=y
```

## main_unit/sdkconfig.defaults
```kconfig
# Default sdkconfig for esp32-smart-keyboard (common to every target).
# Per-target overrides live in sdkconfig.defaults.<target>.

CONFIG_PARTITION_TABLE_CUSTOM=y
CONFIG_PARTITION_TABLE_CUSTOM_FILENAME="partitions.csv"

# Compiler
CONFIG_COMPILER_OPTIMIZATION_PERF=y

# FreeRTOS
CONFIG_FREERTOS_HZ=1000

# Bluetooth -- BLE only, via NimBLE host.
CONFIG_BT_ENABLED=y
CONFIG_BT_NIMBLE_ENABLED=y
CONFIG_BT_NIMBLE_ROLE_PERIPHERAL=y
CONFIG_BT_NIMBLE_ROLE_BROADCASTER=y
CONFIG_BT_NIMBLE_ROLE_CENTRAL=n
CONFIG_BT_NIMBLE_ROLE_OBSERVER=n
CONFIG_BT_NIMBLE_SM_LEGACY=y
CONFIG_BT_NIMBLE_SM_SC=y
CONFIG_BT_NIMBLE_NVS_PERSIST=y
CONFIG_BT_NIMBLE_MAX_CONNECTIONS=1

# NVS for BLE bonding + runtime settings.
CONFIG_NVS_ENCRYPTION=n

# Newlib stdio: line-buffered, with C++ exceptions kept off.
CONFIG_NEWLIB_STDOUT_LINE_ENDING_CRLF=y

# TinyUSB: enable the HID class (1 instance: composite keyboard +
# mouse). Without this, esp_tinyusb compiles with CFG_TUD_HID=0 and
# tud_hid_*_report() symbols are missing -> link error in usb_hid.c.
# The setting is silently ignored on builds that don't pull in the
# esp_tinyusb managed component (i.e. when the BLE HID transport is
# selected, or on classic ESP32 which has no USB OTG).
CONFIG_TINYUSB_HID_COUNT=1
```
